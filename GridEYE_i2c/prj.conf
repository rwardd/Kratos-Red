## CMakeLists.txt
```
set(BOARD particle_argon)
set(CONF_FILE prj.conf)
set(DTC_OVERLAY_FILE argon.overlay)
cmake_minimum_required(VERSION 3.20.0)

find_package(Zephyr REQUIRED HINTS $ENV{ZEPHYR_BASE})
project(argon_i2c)

include_directories(
                      ~/csse4011/repo/project/argon/lib/
                      )

target_sources(app PRIVATE
  src/main.c
  ~/csse4011/repo/project/argon/lib/argon_i2c.c
)
```

## prj.conf
```kconfig
CONFIG_GPIO=y

#RTT
CONFIG_USE_SEGGER_RTT=y

CONFIG_RTT_CONSOLE=y
CONFIG_UART_CONSOLE=n

#i2c
CONFIG_I2C=y

CONFIG_CBPRINTF_FP_SUPPORT=y
```

## argon.overlay
```dts
/*
 *
 * Overlay
 *
 *
 */

 &i2c0 {
     compatible = "nordic,nrf-twi";
     status = "okay";
     sda-pin = <26>;
     scl-pin = <27>;
 };
```

## src/main.c
```c
#include <zephyr.h>
#include "argon_i2c.h"

#define ARGON_PRIO 1
#define ARGON_STACK_SIZE 512

K_THREAD_DEFINE(argonTID, ARGON_STACK_SIZE,
		amg8833_thread_entry, NULL, NULL, NULL,
		ARGON_PRIO, 0, 0);
```
